## meta-ast_bsp/conf/layer.conf
```bitbake
# We have a conf and classes directory, add to BBPATH
BBPATH .= ":${LAYERDIR}"

# We have recipes-* directories, add to BBFILES
BBFILES += "${LAYERDIR}/recipes-*/*/*.bb \
            ${LAYERDIR}/recipes-*/*/*.bbappend"

BBFILE_COLLECTIONS += "meta-ast_bsp"
BBFILE_PATTERN_meta-ast_bsp = "^${LAYERDIR}/"
BBFILE_PRIORITY_meta-ast_bsp = "6"

LAYERDEPENDS_meta-ast_bsp = "core"
LAYERSERIES_COMPAT_meta-ast_bsp = "honister"
```

## meta-ast_bsp/conf/machine/ast_g5_bsp.conf
```bitbake
KERNEL_DEVICETREE = "aspeed-ast2500-evb.dtb"
UBOOT_MACHINE = "ast_g5_phy_config"
#UBOOT_CONFIG = "evb-ast2500_defconfig"

UBOOT_DEVICETREE = "ast2500-romulus"

require conf/machine/include/ast2500.inc
require conf/machine/include/obmc-evb-common.inc
require conf/machine/include/obmc-bsp-common.inc

SERIAL_CONSOLES = "115200;ttyS4"

PREFERRED_PROVIDER_virtual/kernel ?= "linux-aspeed"
PREFERRED_PROVIDER_virtual/bootloader ?= "u-boot-aspeed"
PREFERRED_PROVIDER_u-boot ?= "u-boot-aspeed"
PREFERRED_PROVIDER_u-boot-fw-utils ?= "u-boot-fw-utils-aspeed"

#PREFERRED_PROVIDER_virtual/bootloader:aspeed-g6 ?= "u-boot-aspeed-sdk"
#PREFERRED_PROVIDER_u-boot:aspeed-g6 ?= "u-boot-aspeed-sdk"
#PREFERRED_PROVIDER_u-boot-fw-utils:aspeed-g6 ?= "u-boot-fw-utils-aspeed-sdk"

# Build a FIT image and stuff core-image-minimal in it by default.
#KERNEL_IMAGETYPE ?= "fitImage"
#KERNEL_CLASSES ?= "kernel-fitimage"
#INITRAMFS_IMAGE ?= "aspeed-image-initramfs"
#INITRAMFS_FSTYPES ?= "cpio.xz"

#require conf/machine/include/ast_bsp.inc
#require conf/machine/include/obmc-bsp-common.inc
#require conf/machine/include/obmc-evb-common.inc


#PREFERRED_PROVIDER_virtual/phosphor-led-manager-config-native = "dl360poc-led-manager-config-native"

#VIRTUAL-RUNTIME_obmc-fan-control ?= "phosphor-pid-control"
```

## meta-ast_bsp/conf/machine/include/ast_bsp.inc
```bitbake
UBOOT_ARCH ?= "arm"

#DISTRO_FEATURES ?= "ipv4 ipv6"

SOC_FAMILY = "aspeed-g5"
#include conf/machine/include/soc-family.inc
MACHINEOVERRIDES .= ":ast_bsp"
DEFAULTTUNE ?= "arm1176jzs"

PREFERRED_PROVIDER_virtual/kernel ?= "linux-obmc"

PREFERRED_PROVIDER_virtual/bootloader ?= "u-boot-ast_bsp"
PREFERRED_PROVIDER_u-boot ?= "u-boot-ast_bsp"
PREFERRED_PROVIDER_u-boot-fw-utils ?= "u-boot-fw-utils-ast_bsp"

UBOOT_ENTRYPOINT ?= "0x80001000"
UBOOT_LOADADDRESS ?= "0x80001000"

MACHINE_FEATURES += "\
        obmc-phosphor-fan-mgmt \
        obmc-phosphor-chassis-mgmt \
        obmc-phosphor-flash-mgmt \
        obmc-host-ipmi \
        obmc-host-state-mgmt \
        obmc-chassis-state-mgmt \
        obmc-bmc-state-mgmt \
        "

VIRTUAL-RUNTIME_obmc-host-state-manager ?= "x86-power-control"
VIRTUAL-RUNTIME_obmc-chassis-state-manager ?= "x86-power-control"

PREFERRED_PROVIDER_virtual/obmc-host-ipmi-hw = "phosphor-ipmi-kcs"
PREFERRED_PROVIDER_virtual/obmc-chassis-mgmt = "packagegroup-hpe-apps"
PREFERRED_PROVIDER_virtual/obmc-fan-mgmt = "packagegroup-hpe-apps"
PREFERRED_PROVIDER_virtual/obmc-flash-mgmt = "packagegroup-hpe-apps"
PREFERRED_PROVIDER_virtual/obmc-system-mgmt = "packagegroup-hpe-apps"
PREFERRED_PROVIDER_virtual/obmc-host-ctl ?= ""
#PREFERRED_PROVIDER_virtual/phosphor-ipmi-fru-hostfw-config ?= "hostboot-inventory-config-native"

#IMAGE_CLASSES:append = " ast_bsp-rootfs-postcommands"
```

## meta-ast_bsp/meta-bsp_board1/conf/layer.conf
```bitbake
# We have a conf and classes directory, add to BBPATH
BBPATH .= ":${LAYERDIR}"

# We have recipes-* directories, add to BBFILES
BBFILES += "${LAYERDIR}/recipes-*/*/*.bb \
            ${LAYERDIR}/recipes-*/*/*.bbappend"

BBFILE_COLLECTIONS += "meta-bsp_board1"
BBFILE_PATTERN_meta-bsp_board1 = "^${LAYERDIR}/"
BBFILE_PRIORITY_meta-bsp_board1 = "6"

LAYERDEPENDS_meta-bsp_board1 = "core"
LAYERSERIES_COMPAT_meta-bsp_board1 = "honister"
```
